//
// MyChip Mask Back light
// Device: Arduino Pro or Pro Mini (ATmega 328p 5V)
//
// --------------------------------------------------------------
// NeoPixel Ring simple sketch (c) 2013 Shae Erisson
// Released under the GPLv3 license to match the rest of the
// Adafruit NeoPixel library

#include "Adafruit_NeoPixel.h"
#include <avr/pgmspace.h>

// Which pin on the Arduino is connected to the NeoPixels?
#define L_KEY_DOWN  5
#define L_KEY_UP    6
#define PIXEL_PIN   7 // NeoPixel
#define R_KEY_DOWN  8
#define R_KEY_UP    9

// How many NeoPixels are attached to the Arduino?
#define NUMPIXELS 64 // Popular NeoPixel ring size

// When setting up the NeoPixel library, we tell it how many pixels,
// and which pin to use to send signals. Note that for older NeoPixel
// strips you might need to change the third parameter -- see the
// strandtest example for more information on possible values.
Adafruit_NeoPixel pixels(NUMPIXELS*8, PIXEL_PIN, NEO_GRB + NEO_KHZ800);

#define DELAYVAL 1 // Time (in milliseconds) to pause between pixels
int SPEED = 10;

void setup()
{
  pinMode(L_KEY_UP, INPUT_PULLUP);
  pinMode(L_KEY_DOWN, INPUT_PULLUP);
  pinMode(R_KEY_UP, INPUT_PULLUP);
  pinMode(R_KEY_DOWN, INPUT_PULLUP);

  pixels.begin(); // INITIALIZE NeoPixel strip object (REQUIRED)
}

void loop()
{
  SplashRandom();
  SplashWin();
  Splash(2);
  SplashScrollDown(2,1);
  Splash(1);
  SplashScrollDown(1,0);
  Splash(0);
  while(!PongGame());
}

const uint8_t _Splash_0[16][32] PROGMEM = {
  // My Chip
  {0x00,0x00,0x0A,0x00,0x00,0x00,0x0A,0x00,0x00,0x00,0x00,0x00,0x00,0x00,0x0A,0x0A,0x00,0x0A,0x00,0x00,0x00,0x00,0x0A,0x00,0x00,0x00,0x00,0x00,0x00,0x00,0x00,0x00},
  {0x00,0x00,0x0A,0x0A,0x00,0x0A,0x0A,0x00,0x0A,0x00,0x0A,0x00,0x00,0x0A,0x00,0x00,0x00,0x0A,0x00,0x00,0x00,0x00,0x00,0x00,0x00,0x00,0x00,0x00,0x00,0x00,0x00,0x00},
  {0x00,0x00,0x0A,0x00,0x0A,0x00,0x0A,0x00,0x0A,0x00,0x0A,0x00,0x00,0x0A,0x00,0x00,0x00,0x0A,0x0A,0x0A,0x00,0x00,0x0A,0x00,0x0A,0x0A,0x0A,0x00,0x00,0x00,0x00,0x00},
  {0x00,0x00,0x0A,0x00,0x00,0x00,0x0A,0x00,0x00,0x0A,0x0A,0x00,0x00,0x0A,0x00,0x00,0x00,0x0A,0x00,0x00,0x0A,0x00,0x0A,0x00,0x0A,0x00,0x00,0x0A,0x00,0x00,0x00,0x00},
  {0x00,0x00,0x0A,0x00,0x00,0x00,0x0A,0x00,0x00,0x00,0x0A,0x00,0x00,0x00,0x0A,0x0A,0x00,0x0A,0x00,0x00,0x0A,0x00,0x0A,0x00,0x0A,0x0A,0x0A,0x00,0x00,0x00,0x00,0x00},
  {0x00,0x00,0x00,0x00,0x00,0x00,0x00,0x00,0x0A,0x0A,0x00,0x00,0x00,0x00,0x00,0x00,0x00,0x00,0x00,0x00,0x00,0x00,0x00,0x00,0x0A,0x00,0x00,0x00,0x00,0x00,0x00,0x00},
  // on
  {0x00,0x00,0x00,0x00,0x00,0x00,0x00,0x00,0x00,0x00,0x00,0x14,0x00,0x00,0x14,0x14,0x00,0x00,0x00,0x00,0x00,0x00,0x00,0x00,0x0F,0x00,0x00,0x00,0x00,0x00,0x00,0x00},
  {0x00,0x00,0x00,0x00,0x00,0x00,0x00,0x00,0x00,0x00,0x14,0x00,0x14,0x00,0x14,0x00,0x14,0x00,0x00,0x00,0x00,0x00,0x00,0x00,0x00,0x00,0x00,0x00,0x00,0x00,0x00,0x00},
  {0x00,0x00,0x00,0x00,0x00,0x00,0x00,0x00,0x00,0x00,0x00,0x14,0x00,0x00,0x14,0x00,0x14,0x00,0x00,0x00,0x00,0x00,0x00,0x00,0x00,0x00,0x00,0x00,0x00,0x00,0x00,0x00},
  {0x00,0x00,0x00,0x00,0x00,0x00,0x00,0x00,0x00,0x00,0x00,0x00,0x00,0x00,0x00,0x00,0x00,0x00,0x00,0x00,0x00,0x00,0x00,0x00,0x00,0x00,0x00,0x00,0x00,0x00,0x00,0x00},
  //MyDesk
  {0x00,0x00,0x0A,0x00,0x00,0x00,0x0A,0x00,0x00,0x00,0x00,0x00,0x00,0x0A,0x0A,0x0A,0x00,0x00,0x0A,0x0A,0x0A,0x00,0x00,0x0A,0x0A,0x00,0x0A,0x00,0x00,0x0A,0x00,0x00},
  {0x00,0x00,0x0A,0x0A,0x00,0x0A,0x0A,0x00,0x0A,0x00,0x0A,0x00,0x00,0x0A,0x00,0x00,0x0A,0x00,0x0A,0x00,0x00,0x00,0x0A,0x00,0x00,0x00,0x0A,0x00,0x0A,0x00,0x00,0x00},
  {0x00,0x00,0x0A,0x00,0x0A,0x00,0x0A,0x00,0x0A,0x00,0x0A,0x00,0x00,0x0A,0x00,0x00,0x0A,0x00,0x0A,0x0A,0x00,0x00,0x00,0x0A,0x00,0x00,0x0A,0x0A,0x00,0x00,0x00,0x00},
  {0x00,0x00,0x0A,0x00,0x00,0x00,0x0A,0x00,0x00,0x0A,0x0A,0x00,0x00,0x0A,0x00,0x00,0x0A,0x00,0x0A,0x00,0x00,0x00,0x00,0x00,0x0A,0x00,0x0A,0x00,0x0A,0x00,0x00,0x00},
  {0x00,0x00,0x0A,0x00,0x00,0x00,0x0A,0x00,0x00,0x00,0x0A,0x00,0x00,0x0A,0x0A,0x0A,0x00,0x00,0x0A,0x0A,0x0A,0x00,0x0A,0x0A,0x00,0x00,0x0A,0x00,0x00,0x0A,0x00,0x00},
  {0x00,0x00,0x00,0x00,0x00,0x00,0x00,0x00,0x0A,0x0A,0x00,0x00,0x00,0x00,0x00,0x00,0x00,0x00,0x00,0x00,0x00,0x00,0x00,0x00,0x00,0x00,0x00,0x00,0x00,0x00,0x00,0x00}
};

const uint8_t _Splash_1[16][32] PROGMEM = {
  // ETRI -------------------------------------
  {0x00,0x00,0x00,0x00,0x00,0x00,0x00,0x00,0x00,0x00,0x00,0x00,0x00,0x00,0x00,0x00,0x00,0x00,0x00,0x00,0x00,0x00,0x00,0x00,0x00,0x00,0x00,0x00,0x00,0x00,0x00,0x00},
  {0x00,0x00,0x00,0x00,0x00,0x00,0x00,0x00,0x00,0x00,0x00,0x00,0x00,0x00,0x00,0x00,0x00,0x00,0x00,0x00,0x00,0x00,0x00,0x00,0x00,0x00,0x00,0x00,0x00,0x00,0x00,0x00},
  {0x00,0x00,0x00,0x00,0x00,0x00,0x00,0x00,0x00,0x00,0x00,0x00,0x00,0x00,0x00,0x00,0x00,0x00,0x00,0x00,0x00,0x00,0x00,0x00,0x00,0x00,0x00,0x00,0x00,0x00,0x00,0x00},
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  {0x00,0x00,0x00,0x00,0x00,0x00,0x00,0x00,0x00,0x00,0x00,0x00,0x00,0x00,0x00,0x00,0x00,0x00,0x00,0x00,0x00,0x00,0x00,0x00,0x00,0x00,0x00,0x00,0x00,0x00,0x00,0x00}
};

const uint8_t _Splash_2[16][32] PROGMEM = {
  // My Chip
  {0x00,0x00,0x00,0x00,0x00,0x00,0x00,0x00,0x00,0x00,0x00,0x00,0x00,0x00,0x00,0x00,0x00,0x00,0x00,0x00,0x00,0x00,0x00,0x00,0x00,0x00,0x00,0x00,0x00,0x00,0x00,0x00},
  {0x00,0x00,0x00,0x00,0x00,0x00,0x00,0x00,0x00,0x00,0x00,0x00,0x00,0x00,0x00,0x00,0x00,0x00,0x00,0x00,0x00,0x00,0x00,0x00,0x00,0x00,0x00,0x00,0x00,0x00,0x00,0x00},
  {0x00,0x00,0x00,0x00,0x00,0x00,0x00,0x00,0x00,0x00,0x00,0x00,0x00,0x00,0x00,0x00,0x00,0x00,0x00,0x00,0x00,0x00,0x00,0x00,0x00,0x00,0x00,0x00,0x00,0x00,0x00,0x00},
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  {0x00,0x00,0x00,0x00,0x00,0x00,0x00,0x00,0x00,0x00,0x00,0x00,0x00,0x00,0x00,0x00,0x00,0x00,0x00,0x00,0x00,0x00,0x00,0x00,0x00,0x00,0x00,0x00,0x00,0x00,0x00,0x00}
};

uint16_t  _Score[32];

void SetPixel(uint16_t x, uint16_t y, uint8_t R, uint8_t G, uint8_t B, bool bShow)
{
  pixels.setPixelColor(
    (y/8)*256 +               // Page
    ((x*8+7)+(NUMPIXELS*x%8)) // X
    -(y%8),                   // Y
    pixels.Color(R, G, B));   // Color

  if (bShow)
    pixels.show();
}

void SplashRandom()
{
  for (int y = 0; y<16; y++)
  {
    for (int x = 0; x<32; x++)
      SetPixel(x, y, random(32), random(32), random(32), false);
  }
  pixels.show();
  delay(500);
  //pixels.clear(); // Set all pixel colors to 'off'
}

void SplashWin()
{
  do
  {
    for (int y=0, x=0; x<32; x++)
      SetPixel(x, y, random(32), random(32), random(32), false);
    for (int y=15, x=0; x<32; x++)
      SetPixel(x, y, random(32), random(32), random(32), false);
    for (int x=0, y=1; y<15; y++)
      SetPixel(x, y, random(32), random(32), random(32), false);
    for (int x=31, y=1; y<15; y++)
      SetPixel(x, y, random(32), random(32), random(32), false);
    pixels.show();
    delay(100);
  } while(digitalRead(R_KEY_UP) && digitalRead(R_KEY_DOWN));
  if(!digitalRead(R_KEY_UP))        SPEED = 5;
  else if(!digitalRead(R_KEY_DOWN)) SPEED = 10;
}

void SplashScrollDown(int from, int to)
{
  uint8_t RGB, R, G, B;

  for (int z=0; z<16; z++)
  {
    for (int y=0; y<(16-z); y++)
    {
      for (int x=0; x<32; x++)
      {
        if (from==0)
          RGB = pgm_read_byte(&_Splash_0[y][x]);
        else if (from==1)
          RGB = pgm_read_byte(&_Splash_1[y][x]);
        else if (from==2)
          RGB = pgm_read_byte(&_Splash_2[y][x]);
        else
          return;
        R = (RGB & 0x30)*4;
        G = (RGB & 0x0C)*4;
        B = (RGB & 0x03)*4;
        SetPixel(x, y+z, R, G, B, false);
      }
    }

    for (int y=15; y>=(15-z); y--)
    {
      for (int x=0; x<32; x++)
      {
        if (to==0)
          RGB = pgm_read_byte(&_Splash_0[15-y][x]);
        else if (to==1)
          RGB = pgm_read_byte(&_Splash_1[15-y][x]);
        else if (to==2)        
          RGB = pgm_read_byte(&_Splash_2[15-y][x]);
        else
          return;
        R = (RGB & 0x30)*4;
        G = (RGB & 0x0C)*4;
        B = (RGB & 0x03)*4;
        SetPixel(x, (15-y), R, G, B, false);
      }
    }
    pixels.show();
    delay(10);
  }
}

void Splash(int n)
{
  while(!digitalRead(R_KEY_UP) || !digitalRead(R_KEY_DOWN)) delay(100); // Check Key State

  for (int y=0; y<16; y++)
  {
    for (int x=0; x<32; x++)
    {
      uint8_t RGB;
      if (n==0)       RGB = pgm_read_byte(&_Splash_0[y][x]);
      else if (n==1)  RGB = pgm_read_byte(&_Splash_1[y][x]);
      else if (n==2)  RGB = pgm_read_byte(&_Splash_2[y][x]);
      else            return;
      uint8_t R = (RGB & 0x30)*4;
      uint8_t G = (RGB & 0x0C)*4;
      uint8_t B = (RGB & 0x03)*4;
      SetPixel(x, y, R, G, B, false);
    }
  }

  pixels.show();
  delay(1000);
}

bool ScoreBoard(bool bInit)
{
  int addr = 0;

  for (int y=0; y<16; y++)
  {
    for (int x=0; x<32; x++)
    {
      if (bInit)
        _Score[x] |= ((pgm_read_byte(&_Splash_0[y][x]))? 0x01:0x00)<<y;
      else if (_Score[x])
        return true;
    }
  }
  
  return false;
}

//-------------------------------------------------------------------------------
bool PongGame()
{
  static bool   bInit = true;
  static int8_t ball_x, ball_y;
  static bool   ball_x_dir, ball_y_dir, disable_y = false;
  static int8_t r_paddle_y, l_paddle_y;

  if (bInit)
  {
    ball_x = 2;
    ball_y = random(15);
    ball_x_dir = ball_y_dir = true;

    l_paddle_y = random(12);
    r_paddle_y = random(12);

    bInit = false;

    ScoreBoard(true); // Init
  }

  // Paddle -----------------------------------------------------
  DrawPaddle_R( r_paddle_y, true);  // Erase
  if (r_paddle_y<12 && !digitalRead(R_KEY_UP))    r_paddle_y++;
  if (r_paddle_y>0  && !digitalRead(R_KEY_DOWN))  r_paddle_y--;
  DrawPaddle_R( r_paddle_y, false);
  DrawPaddle_L( l_paddle_y, true);  // Erase
  if (l_paddle_y<12 && !digitalRead(L_KEY_UP))    l_paddle_y++;
  if (l_paddle_y>0  && !digitalRead(L_KEY_DOWN))  l_paddle_y--;
  DrawPaddle_L( l_paddle_y, false);  // Erase

  // Ball ------------------------------------------------------
  DrawBall(ball_x, ball_y, 0, 0, 0);  // Erase Ball

  // Ball X position------------------------
  if (ball_x_dir) ball_x++;
  else            ball_x--;
  // Ball Y position------------------------
  if (!disable_y)
  {
    if (ball_y_dir)
    {
      ball_y += 1;
      if (ball_y>14)
      {
        ball_y = 14;
        ball_y_dir = false;
      }
    }
    else
    {
      ball_y -= 1;
      if (ball_y<0)
      {
        ball_y = 0;
        ball_y_dir = true;
      }
    }
  }
  else
    disable_y = false;

  if (ball_x>28)  // Ball impact Right Paddle ---------------------------------
  {
    if (ball_y<=(r_paddle_y+3) && (ball_y+1)>=r_paddle_y) // Paddle smash Ball
    {
      if (!ScoreBoard(false)) // Cleared?
      {
        Splash(2);
        SplashWin();  // Yeah!
        Splash(1);
        Splash(0);
        bInit = true;

        return true;  // End of Game
      }

      ball_x -= 1;
      ball_x_dir = false;

      // Special effect!
      if ((ball_y+1)==r_paddle_y) // Ball smashed upper edge
        ball_y_dir = false;
      else if (ball_y==(r_paddle_y+3)) // Ball smashed lower edge
        ball_y_dir = true;
      else if (ball_y==(r_paddle_y+1))
        disable_y = true;
      else
        disable_y = false;
    }
    else   // R-Paddle missed Ball
    {
      DrawBall(ball_x, ball_y, 0, 32, 0); // Draw Ball
      pixels.show();
      delay(100);
      DrawBall(ball_x, ball_y, 0, 0, 0); // Erase Ball
      pixels.show();
      DrawBall(ball_x+1, ball_y, 0, 32, 0); // Draw Ball
      pixels.show();
      delay(200);

      Splash(2);
      SplashScrollDown(2,1);
      Splash(1);
      SplashScrollDown(1,0);
      Splash(0);
      
      ball_x = 2;

      ScoreBoard(true); // Init. Restart Game
    }
  }
  else if (ball_x<2)  // Ball impact Left Paddle ------------------------------
  {
    if (ball_y<=(l_paddle_y+3) && (ball_y+1)>=l_paddle_y) // Paddle smash Ball
    {
      if (!ScoreBoard(false)) // Cleared?
      {
        Splash(2);
        SplashWin();  // Yeah!
        Splash(1);
        Splash(0);
        bInit = true;

        return true;  // End of Game
      }

      ball_x += 1;
      ball_x_dir = true;

      // Special effect!
      if ((ball_y+1)==l_paddle_y) // Ball smashed upper edge
        ball_y_dir = false;
      else if (ball_y==(l_paddle_y+3)) // Ball smashed lower edge
        ball_y_dir = true;
      else if (ball_y==(l_paddle_y+1))
        disable_y = true;
      else
        disable_y = false;
    }
    else   // L-Paddle missed Ball
    {
      DrawBall(ball_x, ball_y, 0, 32, 0); // Draw Ball
      pixels.show();
      delay(100);
      DrawBall(ball_x, ball_y, 0, 0, 0); // Erase Ball
      pixels.show();
      DrawBall(ball_x-1, ball_y, 0, 32, 0); // Draw Ball
      pixels.show();
      delay(200);

      Splash(2);
      SplashScrollDown(2,1);
      Splash(1);
      SplashScrollDown(1,0);
      Splash(0);
      
      ball_x = 28;

      ScoreBoard(true); // Init. Restart Game
    }
  }

  DrawBall(ball_x, ball_y, 0, 32, 0); // Draw Ball

  pixels.show();
  delay(random(SPEED)*SPEED+10);

  return false;
}

void DrawBall( uint8_t ball_x, uint8_t ball_y, uint8_t R, uint8_t G, uint8_t B)
{
  SetPixel(ball_x,   ball_y,   R, G, B, false);
  SetPixel(ball_x+1, ball_y,   R, G, B, false);
  SetPixel(ball_x,   ball_y+1, R, G, B, false);
  SetPixel(ball_x+1, ball_y+1, R, G, B, false);

  _Score[ball_x]   &= ~((0x01)<<(ball_y));
  _Score[ball_x]   &= ~((0x01)<<(ball_y+1));
  _Score[ball_x+1] &= ~((0x01)<<(ball_y));
  _Score[ball_x+1] &= ~((0x01)<<(ball_y)+1);
}

void DrawPaddle_R( uint8_t paddle_y, bool bErase)
{
  for (int x=30; x<32; x++)
  {
    if (bErase)
    {
      SetPixel( x, paddle_y,   0, 0, 0, false);
      SetPixel( x, paddle_y+1, 0, 0, 0, false);
      SetPixel( x, paddle_y+2, 0, 0, 0, false);
      SetPixel( x, paddle_y+3, 0, 0, 0, false);
    }
    else
    {
      SetPixel( x, paddle_y,   0, 0, 32, false);
      SetPixel( x, paddle_y+1, 0, 0, 32, false);
      SetPixel( x, paddle_y+2, 0, 0, 32, false);
      SetPixel( x, paddle_y+3, 0, 0, 32, false);
    }
  }
}

void DrawPaddle_L( uint8_t paddle_y, bool bErase)
{
  for (int x=0; x<2; x++)
  {
    if (bErase)
    {
      SetPixel( x, paddle_y,   0, 0, 0, false);
      SetPixel( x, paddle_y+1, 0, 0, 0, false);
      SetPixel( x, paddle_y+2, 0, 0, 0, false);
      SetPixel( x, paddle_y+3, 0, 0, 0, false);
    }
    else
    {
      SetPixel( x, paddle_y,   32, 0, 0, false);
      SetPixel( x, paddle_y+1, 32, 0, 0, false);
      SetPixel( x, paddle_y+2, 32, 0, 0, false);
      SetPixel( x, paddle_y+3, 32, 0, 0, false);
    }
  }
}
